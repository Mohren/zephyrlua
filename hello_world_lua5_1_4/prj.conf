## CMakeLists.txt
```
cmake_minimum_required(VERSION 3.13.1)

include($ENV{ZEPHYR_BASE}/cmake/app/boilerplate.cmake NO_POLICY_SCOPE)
project(hello_world)

add_library(
	myLib
	src/lauxlib.c
	src/lauxlib.h
	src/lua.h
	src/lapi.c
	src/lapi.h
	src/lbaselib.c
	src/lcode.c
	src/lcode.h
	src/ldblib.c
	src/ldebug.c
	src/ldebug.h
	src/ldo.c
	src/ldo.h
	src/ldump.c
	src/lfunc.c
	src/lfunc.h
	src/lgc.c
	src/lgc.h
	src/linit.c
	src/liolib.c
	src/llex.c
	src/llex.h
	src/llimits.h
	src/lmathlib.c
	src/lmem.c
	src/lmem.h
	src/loadlib.c
	src/lobject.c
	src/lobject.h
	src/lopcodes.c
	src/lopcodes.h
	src/loslib.c
	src/lparser.c
	src/lparser.h
	src/lstate.c
	src/lstate.h
	src/lstring.c
	src/lstring.h
	src/lstrlib.c
	src/ltable.c
	src/ltable.h
	src/ltablib.c
	src/ltm.c
	src/ltm.h
	src/luaconf.h
	src/lualib.h
	src/lundump.c
	src/lundump.h
	src/lvm.c
	src/lvm.h
	src/lzio.c
	src/lzio.h
	)


#FILE(GLOB app_sources src/*.c)
#target_sources(app PRIVATE ${app_sources})
#add_executable(executable src/main.c)

target_sources(app PRIVATE src/main.c)
target_link_libraries(app PRIVATE myLib)
```

## prj.conf
```kconfig
CONFIG_NEWLIB_LIBC=y
CONFIG_OPENOCD_SUPPORT=y
#CONFIG_ARM_MPU=n

#CT_LIBC_NEWLIB_TARGET_CFLAGS="-DMISSING_SYSCALL_NAMES"

CONFIG_DEBUG=y
#CONFIG_SYS_POWER_MANAGEMENT=y
#CONFIG_TICKLESS_IDLE=y
#CONFIG_TICKLESS_KERNEL=y

# nothing here
```

## src/main.c
```c
/*
 * Copyright (c) 2012-2014 Wind River Systems, Inc.
 *
 * SPDX-License-Identifier: Apache-2.0
 */

#include <zephyr.h>
#include <sys/printk.h>

#include <stdio.h>

#include "lua.h"
#include "lauxlib.h"

#include "lualib.h"


int main(void)
{
printk("Hello Home");
 lua_State *L=lua_open();
printk("lua_open");
luaL_openlibs(L); 
printk("luaL_openlibs");
 lua_close(L);
printk("Bye");
 return 0;
}
```

## src/linit.c
```c
/*
** $Id: linit.c,v 1.14.1.1 2007/12/27 13:02:25 roberto Exp $
** Initialization of libraries for lua.c
** See Copyright Notice in lua.h
*/


#define linit_c
#define LUA_LIB

#include "lua.h"

#include "lualib.h"
#include "lauxlib.h"



static const luaL_Reg lualibs[] = {
  {"", luaopen_base},
  {LUA_LOADLIBNAME, luaopen_package},
  {LUA_TABLIBNAME, luaopen_table},
  //{LUA_IOLIBNAME, luaopen_io},
  //{LUA_OSLIBNAME, luaopen_os},
  {LUA_STRLIBNAME, luaopen_string},
  {LUA_MATHLIBNAME, luaopen_math},
  {LUA_DBLIBNAME, luaopen_debug},
  {NULL, NULL}
};


LUALIB_API void luaL_openlibs (lua_State *L) {
  const luaL_Reg *lib = lualibs;
  for (; lib->func; lib++) {
    lua_pushcfunction(L, lib->func);
    lua_pushstring(L, lib->name);
    lua_call(L, 1, 0);
  }
}
```
